## firmware/components/ov02c10/Kconfig
```kconfig
menu "OV02C10 camera sensor (vendor driver)"
    rsource "Kconfig.ov02c10.in"
endmenu
```

## firmware/main/Kconfig.projbuild
```kconfig
menu "Golfriend Ball Dispenser"

    config GOLF_DEVICE_CODE
        string "Device code (same as Pi Desktop/DeviceName, e.g. TGSGF_1F_M1)"
        default ""

    config GOLF_API_BASE_URL
        string "API base URL"
        default "http://golfpoint.milkidea.com/api"

    config GOLF_LOG_TOKEN
        string "Better Stack (Logtail) source token; empty = remote log off. Never commit"
        default ""

    config GOLF_OTA_URL
        string "OTA manifest URL (https://.../manifest.json); empty = OTA off"
        default ""

    config GOLF_OTA_CHECK_INTERVAL_H
        int "OTA check interval in hours"
        range 1 168
        default 6

    config GOLF_OTA_ALLOW_HTTP
        bool "Allow plain http:// for OTA (development only, never in production)"
        default n

    config GOLF_PING_INTERVAL_S
        int "Status report (take_ball_ping) interval in seconds"
        range 10 3600
        default 60

    config GOLF_MOTOR_GPIO
        int "Relay signal GPIO (-1 = not set; must not be a strapping pin)"
        range -1 54
        default -1

    config GOLF_WIFI1_SSID
        string "WiFi 1 SSID (primary)"
        default ""

    config GOLF_WIFI1_PASSWORD
        string "WiFi 1 password"
        default ""

    config GOLF_WIFI2_SSID
        string "WiFi 2 SSID (backup, optional)"
        default ""

    config GOLF_WIFI2_PASSWORD
        string "WiFi 2 password"
        default ""

    config GOLF_UI_DEBUG_CONSOLE
        bool "UI debug console over serial (screen capture, demo screens). Must be off in production"
        default n

endmenu
```
